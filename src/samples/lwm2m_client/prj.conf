## CMakeLists.txt
```
cmake_minimum_required(VERSION 3.20.0)

find_package(Zephyr REQUIRED HINTS $ENV{ZEPHYR_BASE})

project(sirena_lwm2m_client_sample)

target_sources(app PRIVATE
    src/main.c
    src/sample_flow.c
)

target_link_libraries(app PRIVATE sirena_lwm2m)
```

## Kconfig.sample
```
menu "Sirena LwM2M sample"

config SIRENA_LWM2M_SAMPLE_SERVER_URI
	string "LwM2M server URI the sample registers with"
	default "coap://127.0.0.1:5683"
	help
	  The URI of the LwM2M server the sample registers with. The scheme
	  selects the transport binding: "coap" for the plaintext binding,
	  "coaps" for the DTLS binding, "mqtt" and "mqtts" for the MQTT
	  binding.

config SIRENA_LWM2M_SAMPLE_ENDPOINT_NAME
	string "Endpoint name the sample registers with"
	default "sirena-sample"
	help
	  The LwM2M Endpoint Client Name of the sample. The server shows it
	  as the name of the registered endpoint.

config SIRENA_LWM2M_SAMPLE_SECURITY_MODE
	int "Security mode of the sample"
	default 3
	range 0 3
	help
	  The security mode of the Security object of the sample: 0 is the
	  pre-shared key, 2 the certificate and 3 the noSec mode. The
	  bindings implement the pre-shared key, the certificate and the
	  noSec modes; the public key and the certificate with EST modes
	  are not implemented.

config SIRENA_LWM2M_SAMPLE_IDENTITY
	string "Pre-shared key identity of the sample"
	default ""
	help
	  The identity of the pre-shared key of the sample. It is empty for
	  the noSec mode.

config SIRENA_LWM2M_SAMPLE_SECRET_KEY
	string "Pre-shared key of the sample"
	default ""
	help
	  The pre-shared key of the sample. It is empty for the noSec mode.

config SIRENA_LWM2M_SAMPLE_SHORT_SERVER_ID
	int "Short server id of the sample"
	default 1
	range 0 65535

config SIRENA_LWM2M_SAMPLE_LIFETIME
	int "Registration lifetime of the sample in seconds"
	default 300
	range 1 86400

config SIRENA_LWM2M_SAMPLE_BINDING
	string "Binding mode of the sample"
	default "U"
	help
	  The binding mode the sample registers with: "U" for UDP, "T" for TCP
	  and "UQ" for UDP and TCP. The sample writes it to the Binding
	  resource of the Server object, and the client sends it as the "b"
	  parameter of the registration.

config SIRENA_LWM2M_SAMPLE_MANUFACTURER
	string "Manufacturer of the sample device"
	default "Sirena"

config SIRENA_LWM2M_SAMPLE_MODEL_NUMBER
	string "Model number of the sample device"
	default "sirena-sample"

config SIRENA_LWM2M_SAMPLE_SERIAL_NUMBER
	string "Serial number of the sample device"
	default "sirena-sample-0001"

config SIRENA_LWM2M_SAMPLE_FIRMWARE_VERSION
	string "Firmware version of the sample device"
	default "1.0.0"

config SIRENA_LWM2M_SAMPLE_RUN_SECONDS
	int "Lifetime of the sample run in seconds"
	default 10
	range 1 3600
	help
	  The sample stops after this many seconds, deregisters and exits. It
	  never runs forever, so that it terminates on its own in a test run.

config SIRENA_LWM2M_SAMPLE_TELEMETRY_INTERVAL_MS
	int "Interval between the telemetry reports of the sample in milliseconds"
	default 1000
	range 100 60000
	help
	  The interval between the telemetry reports of the sample. The first
	  report is sent after one interval.

endmenu
```

## prj.conf
```kconfig
CONFIG_SIRENA_LWM2M=y
CONFIG_SIRENA_LWM2M_TRANSPORT_COAP=y
CONFIG_SIRENA_LWM2M_TRANSPORT_NOSEC=y
CONFIG_SIRENA_LWM2M_OBJECT_DEVICE_OPTIONAL=y

CONFIG_NETWORKING=y
CONFIG_NET_DRIVERS=y
CONFIG_NET_UDP=y
CONFIG_NET_IPV4=y
CONFIG_NET_SOCKETS=y
CONFIG_NET_LOOPBACK=y
CONFIG_ETH_NATIVE_TAP=n

CONFIG_COAP=y
CONFIG_COAP_CLIENT=y

CONFIG_PRINTK=y
CONFIG_MAIN_STACK_SIZE=2048

CONFIG_SIRENA_LWM2M_COAP_RESPONSE_TIMEOUT_MS=2000
```

## prj-dtls.conf
```kconfig
CONFIG_SIRENA_LWM2M_TRANSPORT_DTLS=y

CONFIG_MBEDTLS=y
CONFIG_MBEDTLS_SSL_SRV_C=y
CONFIG_MBEDTLS_SSL_PROTO_DTLS=y
CONFIG_MBEDTLS_KEY_EXCHANGE_PSK_ENABLED=y
CONFIG_MBEDTLS_PSK_MAX_LEN=64

CONFIG_NET_SOCKETS_SOCKOPT_TLS=y
CONFIG_NET_SOCKETS_ENABLE_DTLS=y
CONFIG_NET_SOCKETS_TLS_MAX_CONTEXTS=4
CONFIG_NET_SOCKETS_TLS_MAX_SESSION_CONTEXTS=16

CONFIG_PSA_WANT_ALG_CCM=y
```

## src/main.c
```c
#include "sample_flow.h"
#include <zephyr/sys/printk.h>

#if defined(CONFIG_BOARD_NATIVE_SIM)
#include <nsi_main.h>
#endif

int main(void)
{
	struct sirena_lwm2m_sample_config config;
	struct sirena_lwm2m_sample_state state;
	int state_rc;
	int rc;

	sirena_lwm2m_sample_config_from_kconfig(&config);

	rc = sirena_lwm2m_sample_run(&config);

	state_rc = sirena_lwm2m_sample_state_read(&state);
	if (state_rc != 0) {
		printk("sirena lwm2m sample: the state could not be read: %d\n", state_rc);
	} else {
		printk("sirena lwm2m sample: finished registered=%d reports=%u notifications=%u "
		       "command=%d\n",
		       state.registered ? 1 : 0, state.telemetry_reports, state.notifications_sent,
		       state.command_handled ? 1 : 0);
	}

#if defined(CONFIG_BOARD_NATIVE_SIM)
	nsi_exit(rc == 0 && state_rc == 0 ? 0 : 1);
#endif

	return rc == 0 && state_rc == 0 ? 0 : 1;
}
```

## src/sample_flow.c
```c
#include "sample_flow.h"
#include <sirena/lwm2m/object_registry.h>
#include <sirena/lwm2m/objects.h>
#include <sirena/lwm2m/protocol.h>
#include <sirena/lwm2m/transport.h>
#include <zephyr/kernel.h>
#include <zephyr/sys/printk.h>
#include <errno.h>
#include <string.h>

static K_MUTEX_DEFINE(sample_lock);
static struct sirena_lwm2m_sample_state sample_state;
static bool sample_reset_pending;

static void sample_state_error(int error)
{
	k_mutex_lock(&sample_lock, K_FOREVER);
	sample_state.last_error = error;
	k_mutex_unlock(&sample_lock);
}

static void sample_state_registered(void)
{
	k_mutex_lock(&sample_lock, K_FOREVER);
	sample_state.registered = true;
	k_mutex_unlock(&sample_lock);
}

static void sample_state_telemetry(int64_t value, uint32_t observers)
{
	k_mutex_lock(&sample_lock, K_FOREVER);
	sample_state.telemetry_reports++;
	sample_state.notifications_sent += observers;
	sample_state.last_telemetry_value = value;
	k_mutex_unlock(&sample_lock);
}

static void sample_execute_handler(uint16_t object_id, uint16_t instance_id,
                                   uint16_t resource_id, void *user_data)
{
	(void)user_data;

	k_mutex_lock(&sample_lock, K_FOREVER);
	sample_state.command_handled = true;
	sample_state.command_object_id = object_id;
	sample_state.command_instance_id = instance_id;
	sample_state.command_resource_id = resource_id;
	if (object_id == SIRENA_LWM2M_SAMPLE_DEVICE_OBJECT_ID &&
	    instance_id == SIRENA_LWM2M_SAMPLE_INSTANCE_ID &&
	    resource_id == SIRENA_LWM2M_SAMPLE_REBOOT_RESOURCE_ID) {
		sample_reset_pending = true;
	}
	k_mutex_unlock(&sample_lock);

	printk("sirena lwm2m sample: command %u/%u/%u received\n", object_id, instance_id,
	       resource_id);
}

static bool sample_reset_take(void)
{
	bool reset;

	k_mutex_lock(&sample_lock, K_FOREVER);
	reset = sample_reset_pending;
	sample_reset_pending = false;
	k_mutex_unlock(&sample_lock);

	return reset;
}

static int sample_set_device_string(uint16_t resource_id, const char *value)
{
	if (value == NULL) {
		return 0;
	}

	return sirena_lwm2m_set_string(SIRENA_LWM2M_SAMPLE_DEVICE_OBJECT_ID,
				       SIRENA_LWM2M_SAMPLE_INSTANCE_ID, resource_id, value);
}

static int sample_prepare(const struct sirena_lwm2m_sample_config *config)
{
	struct sirena_lwm2m_provisioning provisioning = {
		.server_uri = config->server_uri,
		.security_mode = config->security_mode,
		.identity = config->identity,
		.identity_length = config->identity_length,
		.secret_key = config->secret_key,
		.secret_key_length = config->secret_key_length,
		.short_server_id = config->short_server_id,
		.lifetime = config->lifetime,
		.binding = config->binding,
	};
	struct sirena_lwm2m_resource *resource;
	int rc;

	rc = sirena_lwm2m_registry_init();
	if (rc != 0) {
		printk("sirena lwm2m sample: the registry failed: %d\n", rc);
		return rc;
	}

	rc = sirena_lwm2m_objects_init();
	if (rc != 0) {
		printk("sirena lwm2m sample: the objects failed: %d\n", rc);
		return rc;
	}

	rc = sirena_lwm2m_provision(&provisioning);
	if (rc != 0) {
		printk("sirena lwm2m sample: the provisioning failed: %d\n", rc);
		return rc;
	}

	rc = sample_set_device_string(SIRENA_LWM2M_SAMPLE_MANUFACTURER_RESOURCE_ID,
				       config->manufacturer);
	if (rc != 0) {
		printk("sirena lwm2m sample: the manufacturer failed: %d\n", rc);
		return rc;
	}

	rc = sample_set_device_string(SIRENA_LWM2M_SAMPLE_MODEL_RESOURCE_ID,
				       config->model_number);
	if (rc != 0) {
		printk("sirena lwm2m sample: the model number failed: %d\n", rc);
		return rc;
	}

	rc = sample_set_device_string(SIRENA_LWM2M_SAMPLE_SERIAL_RESOURCE_ID,
				       config->serial_number);
	if (rc != 0) {
		printk("sirena lwm2m sample: the serial number failed: %d\n", rc);
		return rc;
	}

	rc = sample_set_device_string(SIRENA_LWM2M_SAMPLE_FIRMWARE_RESOURCE_ID,
				       config->firmware_version);
	if (rc != 0) {
		printk("sirena lwm2m sample: the firmware version failed: %d\n", rc);
		return rc;
	}

	rc = sirena_lwm2m_find_resource(SIRENA_LWM2M_SAMPLE_DEVICE_OBJECT_ID,
					SIRENA_LWM2M_SAMPLE_INSTANCE_ID,
					SIRENA_LWM2M_SAMPLE_BATTERY_RESOURCE_ID, &resource);
	if (rc != 0) {
		printk("sirena lwm2m sample: the telemetry resource %u is not registered\n",
		       SIRENA_LWM2M_SAMPLE_BATTERY_RESOURCE_ID);
		return -ENOTSUP;
	}

	rc = sirena_lwm2m_set_execute_handler(sample_execute_handler, NULL);
	if (rc != 0) {
		printk("sirena lwm2m sample: the execute handler failed: %d\n", rc);
		return rc;
	}

	rc = sirena_lwm2m_transport_set_endpoint_name(config->endpoint_name);
	if (rc != 0) {
		printk("sirena lwm2m sample: the endpoint name failed: %d\n", rc);
		return rc;
	}

	return 0;
}

static void sample_run_telemetry(const struct sirena_lwm2m_sample_config *config)
{
	int64_t deadline = k_uptime_get() + (int64_t)config->run_seconds * 1000;
	int64_t value = SIRENA_LWM2M_SAMPLE_BATTERY_START;

	while (k_uptime_get() < deadline) {
		struct sirena_lwm2m_value telemetry_value = {
			.type = SIRENA_LWM2M_VALUE_INTEGER,
		};
		int rc;

		k_sleep(K_MSEC(config->telemetry_interval_ms));

		if (sample_reset_take()) {
			value = SIRENA_LWM2M_SAMPLE_BATTERY_START;
		} else if (value > 0) {
			value -= SIRENA_LWM2M_SAMPLE_BATTERY_STEP;
		}

		telemetry_value.data.integer = value;

		rc = sirena_lwm2m_set_value(SIRENA_LWM2M_SAMPLE_DEVICE_OBJECT_ID,
					    SIRENA_LWM2M_SAMPLE_INSTANCE_ID,
					    SIRENA_LWM2M_SAMPLE_BATTERY_RESOURCE_ID,
					    &telemetry_value);
		if (rc != 0) {
			printk("sirena lwm2m sample: the telemetry value failed: %d\n", rc);
			continue;
		}

		rc = sirena_lwm2m_notify_resource(SIRENA_LWM2M_SAMPLE_DEVICE_OBJECT_ID,
						  SIRENA_LWM2M_SAMPLE_INSTANCE_ID,
						  SIRENA_LWM2M_SAMPLE_BATTERY_RESOURCE_ID);
		if (rc < 0) {
			printk("sirena lwm2m sample: the notification failed: %d\n", rc);
			continue;
		}

		sample_state_telemetry(value, (uint32_t)rc);

		printk("sirena lwm2m sample: telemetry %lld published to %d observers\n",
		       (long long)value, rc);
	}
}

void sirena_lwm2m_sample_config_from_kconfig(struct sirena_lwm2m_sample_config *config)
{
	if (config == NULL) {
		return;
	}

	memset(config, 0, sizeof(*config));

	config->server_uri = CONFIG_SIRENA_LWM2M_SAMPLE_SERVER_URI;
	config->endpoint_name = CONFIG_SIRENA_LWM2M_SAMPLE_ENDPOINT_NAME;
	config->security_mode = (uint8_t)CONFIG_SIRENA_LWM2M_SAMPLE_SECURITY_MODE;
	config->identity = CONFIG_SIRENA_LWM2M_SAMPLE_IDENTITY;
	config->identity_length = sizeof(CONFIG_SIRENA_LWM2M_SAMPLE_IDENTITY) - 1U;
	config->secret_key = CONFIG_SIRENA_LWM2M_SAMPLE_SECRET_KEY;
	config->secret_key_length = sizeof(CONFIG_SIRENA_LWM2M_SAMPLE_SECRET_KEY) - 1U;
	config->short_server_id = (uint16_t)CONFIG_SIRENA_LWM2M_SAMPLE_SHORT_SERVER_ID;
	config->lifetime = (uint32_t)CONFIG_SIRENA_LWM2M_SAMPLE_LIFETIME;
	config->binding = CONFIG_SIRENA_LWM2M_SAMPLE_BINDING;
	config->manufacturer = CONFIG_SIRENA_LWM2M_SAMPLE_MANUFACTURER;
	config->model_number = CONFIG_SIRENA_LWM2M_SAMPLE_MODEL_NUMBER;
	config->serial_number = CONFIG_SIRENA_LWM2M_SAMPLE_SERIAL_NUMBER;
	config->firmware_version = CONFIG_SIRENA_LWM2M_SAMPLE_FIRMWARE_VERSION;
	config->run_seconds = (uint32_t)CONFIG_SIRENA_LWM2M_SAMPLE_RUN_SECONDS;
	config->telemetry_interval_ms = (uint32_t)CONFIG_SIRENA_LWM2M_SAMPLE_TELEMETRY_INTERVAL_MS;
}

int sirena_lwm2m_sample_state_read(struct sirena_lwm2m_sample_state *state)
{
	if (state == NULL) {
		return -EINVAL;
	}

	k_mutex_lock(&sample_lock, K_FOREVER);
	*state = sample_state;
	k_mutex_unlock(&sample_lock);

	return 0;
}

int sirena_lwm2m_sample_run(const struct sirena_lwm2m_sample_config *config)
{
	int rc;

	if (config == NULL) {
		return -EINVAL;
	}

	k_mutex_lock(&sample_lock, K_FOREVER);
	memset(&sample_state, 0, sizeof(sample_state));
	sample_reset_pending = false;
	k_mutex_unlock(&sample_lock);

	rc = sample_prepare(config);
	if (rc != 0) {
		sample_state_error(rc);
		return rc;
	}

	printk("sirena lwm2m sample: registering with %s as %s\n", config->server_uri,
	       config->endpoint_name);

	rc = sirena_lwm2m_transport_start();
	if (rc != 0) {
		printk("sirena lwm2m sample: the transport failed: %d\n", rc);
		sample_state_error(rc);
		return rc;
	}

	rc = sirena_lwm2m_transport_register();
	if (rc != 0) {
		printk("sirena lwm2m sample: the registration failed: %d\n", rc);
		sample_state_error(rc);
	} else {
		sample_state_registered();
		printk("sirena lwm2m sample: registered\n");
	}

	sample_run_telemetry(config);

	rc = sirena_lwm2m_transport_deregister();
	if (rc != 0) {
		printk("sirena lwm2m sample: the deregistration failed: %d\n", rc);
		sample_state_error(rc);
	} else {
		printk("sirena lwm2m sample: deregistered\n");
	}

	return 0;
}
```

## src/sample_flow.h
```c
#ifndef SIRENA_LWM2M_SAMPLE_FLOW_H
#define SIRENA_LWM2M_SAMPLE_FLOW_H

#include <stdbool.h>
#include <stddef.h>
#include <stdint.h>

#define SIRENA_LWM2M_SAMPLE_DEVICE_OBJECT_ID 3U
#define SIRENA_LWM2M_SAMPLE_INSTANCE_ID 0U
#define SIRENA_LWM2M_SAMPLE_MANUFACTURER_RESOURCE_ID 0U
#define SIRENA_LWM2M_SAMPLE_MODEL_RESOURCE_ID 1U
#define SIRENA_LWM2M_SAMPLE_SERIAL_RESOURCE_ID 2U
#define SIRENA_LWM2M_SAMPLE_FIRMWARE_RESOURCE_ID 3U
#define SIRENA_LWM2M_SAMPLE_BATTERY_RESOURCE_ID 9U
#define SIRENA_LWM2M_SAMPLE_REBOOT_RESOURCE_ID 4U
#define SIRENA_LWM2M_SAMPLE_BATTERY_START 100
#define SIRENA_LWM2M_SAMPLE_BATTERY_STEP 5

struct sirena_lwm2m_sample_config {
	const char *server_uri;
	const char *endpoint_name;
	uint8_t security_mode;
	const void *identity;
	size_t identity_length;
	const void *secret_key;
	size_t secret_key_length;
	uint16_t short_server_id;
	uint32_t lifetime;
	const char *binding;
	const char *manufacturer;
	const char *model_number;
	const char *serial_number;
	const char *firmware_version;
	uint32_t run_seconds;
	uint32_t telemetry_interval_ms;
};

struct sirena_lwm2m_sample_state {
	bool registered;
	bool command_handled;
	uint16_t command_object_id;
	uint16_t command_instance_id;
	uint16_t command_resource_id;
	uint32_t telemetry_reports;
	uint32_t notifications_sent;
	int64_t last_telemetry_value;
	int last_error;
};

void sirena_lwm2m_sample_config_from_kconfig(struct sirena_lwm2m_sample_config *config);
int sirena_lwm2m_sample_run(const struct sirena_lwm2m_sample_config *config);
int sirena_lwm2m_sample_state_read(struct sirena_lwm2m_sample_state *state);

#endif
```
