## Kconfig
```kconfig
config SIRENA_LWM2M_MAX_OBJECTS
	int "Maximum number of registered objects"
	default 8
	range 1 256

config SIRENA_LWM2M_MAX_INSTANCES
	int "Maximum number of object instances"
	default 16
	range 1 1024

config SIRENA_LWM2M_MAX_RESOURCES_PER_INSTANCE
	int "Maximum number of resources per instance"
	default 25 if SIRENA_LWM2M_OBJECT_SECURITY_OPTIONAL || SIRENA_LWM2M_OBJECT_DEVICE_OPTIONAL
	default 16
	range 1 256

config SIRENA_LWM2M_CODEC_MAX_VALUE_SIZE
	int "Maximum codec value size"
	default 64
	range 1 4096

config SIRENA_LWM2M_CODEC_MAX_VALUES
	int "Maximum codec values per call"
	default 8
	range 1 64

config SIRENA_LWM2M_MAX_OBSERVATIONS
	int "Maximum number of concurrent observations"
	default 8
	range 1 64

config SIRENA_LWM2M_PREFERRED_CONTENT_FORMAT
	int "Preferred content format of the client"
	default 11542
	range 0 65535
	help
	  The content format the client uses when the server does not
	  state an acceptable format. The default is the TLV format,
	  which the codec encodes for every resource type. The plain
	  text format, which is the format identifier zero, only
	  encodes string resources.

config SIRENA_LWM2M_PROTOCOL_PAYLOAD_MAX
	int "Maximum size of an encoded resource payload"
	default 256
	range 32 1024

config SIRENA_LWM2M_PROTOCOL_VALUE_MAX
	int "Maximum size of a raw resource value"
	default 64
	range 8 512

config SIRENA_LWM2M_ACCEPTED_FORMATS_MAX
	int "Maximum number of acceptable content formats in one request"
	default 4
	range 1 16

config SIRENA_LWM2M_ENGINE_POLL_INTERVAL_MS
	int "Engine thread poll interval in milliseconds"
	default 20
	range 1 1000
	help
	  The engine thread polls the transport socket with this
	  interval while it waits for work. It bounds the latency of a
	  server request and the resolution of the retransmission
	  timers of a pending request.

menu "Sirena LwM2M"

config SIRENA_LWM2M
	bool "Enable Sirena LwM2M client core"
	default y

if SIRENA_LWM2M

config SIRENA_LWM2M_OBJECT_SECURITY_OPTIONAL
	bool "Enable optional Security object (0) resources"
	default n

config SIRENA_LWM2M_OBJECT_SERVER_OPTIONAL
	bool "Enable optional Server object (1) resources"
	default n

config SIRENA_LWM2M_OBJECT_DEVICE_OPTIONAL
	bool "Enable optional Device object (3) resources"
	default n

config SIRENA_LWM2M_LWM2M_VERSION
	string "LwM2M version the client announces in the registration"
	default "1.2"
	help
	  The version the client announces in the "lwm2m" parameter of its
	  CoAP registration and in the "version" member of its MQTT
	  registration. A client announces one LwM2M version, so the
	  symbol drives every binding. It has to be a version the server
	  supports: Leshan knows 1.0 and 1.1 only, the Sirena server knows
	  1.0, 1.1 and 1.2.

config SIRENA_LWM2M_SERVER_URI_MAX
	int "Maximum length of the LwM2M server URI"
	default 64
	range 16 512

config SIRENA_LWM2M_CREDENTIAL_MAX
	int "Maximum size of a PSK credential and SMS-binding material"
	default 128 if SIRENA_LWM2M_TRANSPORT_DTLS || SIRENA_LWM2M_TRANSPORT_MQTT
	default 32
	range 8 1024
	help
	  Size of the buffers that hold the PSK identity, the server public
	  key and the secret key, plus the optional SMS binding material. The
	  DTLS and MQTT bindings raise the default when they are enabled.
	  X.509 certificate, trust-anchor and private-key buffers are sized
	  by CONFIG_SIRENA_LWM2M_CERTIFICATE_MAX instead.

config SIRENA_LWM2M_CERTIFICATE_MAX
	int "Maximum size of X.509 certificate material (client cert, trust anchor, private key)"
	default 4096
	range 256 8192
	help
	  Size of the buffers that hold the client certificate, the trust
	  anchor (CA) and the private key of the Security object. The same
	  buffers carry PSK identity, public key and secret key material, so
	  a build that enables certificate support pays this size in any
	  security mode. Realistic DER certificate material needs far more
	  room than a pre-shared key, and this symbol provides it without
	  changing the PSK-specific CREDENTIAL_MAX limit.

config SIRENA_LWM2M_SERVER_STRING_MAX
	int "Maximum length of a server side string (binding, optional strings)"
	default 32
	range 8 512

config SIRENA_LWM2M_DEVICE_STRING_MAX
	int "Maximum length of a device metadata string"
	default 32
	range 8 512

config SIRENA_LWM2M_ENGINE_QUEUE_SIZE
	int "Maximum number of queued engine requests"
	default 8
	range 1 64

config SIRENA_LWM2M_ENGINE_STACK_SIZE
	int "Engine thread stack size in bytes"
	default 2048
	range 512 16384

config SIRENA_LWM2M_ENGINE_PRIORITY
	int "Engine thread priority"
	default 5
	range -32 32

config SIRENA_LWM2M_ENDPOINT_NAME_MAX
	int "Maximum length of the LwM2M endpoint client name"
	default 32
	range 8 128
	help
	  The endpoint client name is carried in a CoAP URI-Query option, so
	  CONFIG_COAP_EXTENDED_OPTIONS_LEN_VALUE has to hold the name and
	  the "ep=" prefix.

config SIRENA_LWM2M_LOCATION_PATH_MAX
	int "Maximum length of the stored registration location path"
	default 64
	range 16 256

config SIRENA_LWM2M_REGISTRATION_PAYLOAD_MAX
	int "Maximum length of the registration link-format payload"
	default 256
	range 32 1024

config SIRENA_LWM2M_COAP_RESPONSE_TIMEOUT_MS
	int "CoAP response timeout in milliseconds"
	default 10000
	range 100 60000

config SIRENA_LWM2M_TRANSPORT_COAP
	bool "Enable the CoAP/UDP transport binding"
	default y
	depends on COAP && COAP_CLIENT
	select COAP_EXTENDED_OPTIONS_LEN
	help
	  Enables the plain CoAP over UDP transport binding. The binding
	  registers with the LwM2M server, updates the registration and
	  deregisters. DTLS, observation and read, write and execute are not
	  part of this binding.

config SIRENA_LWM2M_TRANSPORT_DTLS
	bool "Enable the CoAP/DTLS transport binding"
	default y
	depends on COAP && COAP_CLIENT && NET_SOCKETS && MBEDTLS && NET_SOCKETS_SOCKOPT_TLS
	select COAP_EXTENDED_OPTIONS_LEN
	select NET_SOCKETS_ENABLE_DTLS
	select PSA_WANT_ALG_HMAC
	select PSA_WANT_ALG_SHA_384
	select MBEDTLS_SSL_PROTO_TLS1_2
	select MBEDTLS_SSL_PROTO_DTLS
	select MBEDTLS_KEY_EXCHANGE_PSK_ENABLED
	select MBEDTLS_CIPHERSUITE_TLS_ECDHE_ECDSA_WITH_AES_128_CCM_8
	select MBEDTLS_X509_CRT_PARSE_C
	select MBEDTLS_KEY_EXCHANGE_ECDHE_ECDSA_ENABLED
	select PSA_WANT_ALG_CCM
	select PSA_WANT_ALG_SHA_256
	select PSA_WANT_ALG_TLS12_PRF
	select PSA_WANT_ALG_TLS12_PSK_TO_MS
	select PSA_WANT_KEY_TYPE_AES
	select PSA_WANT_KEY_TYPE_DERIVE
	help
	  Enables the secure CoAP over DTLS transport binding. The binding
	  reads the credentials of the Security object, a pre-shared key or
	  an X.509 certificate, and registers with the LwM2M server over
	  DTLS 1.2. It needs mbed TLS with the key exchange enabled, so the
	  application has to enable CONFIG_MBEDTLS and
	  CONFIG_NET_SOCKETS_SOCKOPT_TLS.

	  The binding selects the HMAC and the SHA-384 algorithms of mbed
	  TLS. The TLS 1.2 master secret is 48 bytes long and the static
	  PSA key slots are sized by the largest hash of the build, so the
	  master secret only fits into a key slot when HMAC and SHA-384 are
	  enabled. An application that enables the mbed TLS heap instead
	  does not need them for the key slot size.

config SIRENA_LWM2M_TRANSPORT_MQTT
	bool "Enable the MQTT transport binding"
	default n
	depends on NET_SOCKETS && NET_TCP && MBEDTLS && NET_SOCKETS_SOCKOPT_TLS
	depends on MQTT_LIB
	select MQTT_LIB_TLS
	select MBEDTLS_SSL_PROTO_TLS1_2
	select MBEDTLS_KEY_EXCHANGE_PSK_ENABLED
	select MBEDTLS_CIPHERSUITE_TLS_ECDHE_ECDSA_WITH_AES_128_CCM_8
	select MBEDTLS_X509_CRT_PARSE_C
	select MBEDTLS_KEY_EXCHANGE_ECDHE_ECDSA_ENABLED
	select PSA_WANT_ALG_CCM
	select PSA_WANT_ALG_HMAC
	select PSA_WANT_ALG_SHA_256
	select PSA_WANT_ALG_SHA_384
	select PSA_WANT_ALG_TLS12_PRF
	select PSA_WANT_ALG_TLS12_PSK_TO_MS
	select PSA_WANT_KEY_TYPE_AES
	select PSA_WANT_KEY_TYPE_DERIVE
	help
	  Enables the MQTT transport binding of OMA LwM2M 1.2. The binding
	  connects to the MQTT broker of the Security object, subscribes to
	  the topic of the endpoint and publishes the registration, the
	  answers and the notifications on it. The payloads are CBOR maps,
	  as the specification defines them.

	  The binding needs the MQTT library of Zephyr, which needs the
	  socket API and TCP, and the TLS socket of Zephyr, which needs
	  mbed TLS with the PSK key exchange. The application has to enable
	  CONFIG_MQTT_LIB, CONFIG_MBEDTLS and CONFIG_NET_SOCKETS_SOCKOPT_TLS.
	  The "mqtt://" scheme talks to the broker in the clear and needs
	  the noSec development gate, the "mqtts://" scheme protects the
	  connection with the credentials of the Security object, a
	  pre-shared key or a certificate.

config SIRENA_LWM2M_MQTT_TOPIC_MAX
	int "Maximum length of the MQTT topic of the endpoint"
	default 128
	range 32 512
	depends on SIRENA_LWM2M_TRANSPORT_MQTT
	help
	  The topic of the endpoint is the prefix, the "lwm2m/rd/" root and
	  the endpoint name. The buffer has to hold all of them.

config SIRENA_LWM2M_MQTT_CLIENT_ID_MAX
	int "Maximum length of the MQTT client identifier"
	default 23
	range 1 23
	depends on SIRENA_LWM2M_TRANSPORT_MQTT
	help
	  MQTT 3.1.1 limits the client identifier to 23 bytes. The endpoint
	  name is used as the client identifier when the application does not
	  set one, and it is cut to this length.

config SIRENA_LWM2M_MQTT_TOPIC_PREFIX_MAX
	int "Maximum length of the MQTT topic prefix"
	default 32
	range 0 SIRENA_LWM2M_MQTT_TOPIC_MAX
	depends on SIRENA_LWM2M_TRANSPORT_MQTT
	help
	  The prefix is the tenant name the specification defines. It is
	  optional and empty by default. It is part of the topic of the
	  endpoint, so it cannot be longer than the topic itself.

config SIRENA_LWM2M_MQTT_BUFFER_SIZE
	int "Size of the MQTT receive and transmit buffers"
	default 512
	range 128 2048
	depends on SIRENA_LWM2M_TRANSPORT_MQTT
	help
	  The buffers hold a whole MQTT packet, so they have to hold the
	  topic, the CBOR payload and the value it carries.

config SIRENA_LWM2M_MQTT_RESPONSE_TIMEOUT_MS
	int "Time the binding waits for a server response in milliseconds"
	default 10000
	range 100 60000
	depends on SIRENA_LWM2M_TRANSPORT_MQTT
	help
	  The binding waits for the answer of the server to the Register,
	  the Update and the Deregister request for this time.

config SIRENA_LWM2M_TRANSPORT_NOSEC
	bool "Allow the NoSec security mode"
	default n
	help
	  Allows the client to talk to a server that uses the NoSec security
	  mode, which means that the traffic is not protected at all. The
	  switch is off by default, so a production build cannot silently
	  talk to a server in the clear. It is meant for development and
	  testing only and it has no effect on the DTLS binding.

config SIRENA_LWM2M_PSK_IDENTITY_MAX
	int "Maximum size of the PSK identity"
	default 128
	range 1 128
	depends on SIRENA_LWM2M_TRANSPORT_DTLS || SIRENA_LWM2M_TRANSPORT_MQTT
	help
	  The OMA LwM2M 1.2 Transport Bindings specification requires support
	  for PSK identities of up to 128 bytes.

config SIRENA_LWM2M_PSK_KEY_MAX
	int "Maximum size of the PSK key"
	default 64
	range 1 64
	depends on SIRENA_LWM2M_TRANSPORT_DTLS || SIRENA_LWM2M_TRANSPORT_MQTT
	help
	  The OMA LwM2M 1.2 Transport Bindings specification requires support
	  for PSK keys of up to 64 bytes. mbed TLS limits the key size with
	  CONFIG_MBEDTLS_PSK_MAX_LEN, which has to be raised to the same
	  size to use a key of more than 32 bytes.

config SIRENA_LWM2M_DTLS_SEC_TAG
	int "Secure tag of the DTLS credentials"
	default 1
	range 1 65535
	depends on SIRENA_LWM2M_TRANSPORT_DTLS
	help
	  The secure tag under which the DTLS binding registers the
	  pre-shared key identity and the pre-shared key with the TLS
	  credential subsystem. A secure tag identifies one set of
	  credentials, so the value has to be unique in the application.

config SIRENA_LWM2M_MQTT_SEC_TAG
	int "Secure tag of the MQTT credentials"
	default 2
	range 1 65535
	depends on SIRENA_LWM2M_TRANSPORT_MQTT
	help
	  The secure tag under which the MQTT binding registers the
	  pre-shared key identity and the pre-shared key with the TLS
	  credential subsystem. A secure tag identifies one set of
	  credentials, so the value has to be unique in the application.

if SIRENA_LWM2M_TRANSPORT_COAP || SIRENA_LWM2M_TRANSPORT_DTLS

config COAP_EXTENDED_OPTIONS_LEN_VALUE
	int "CoAP extended options length value"
	default 64
	depends on COAP_EXTENDED_OPTIONS_LEN
	help
	  The registration carries the endpoint client name in a URI-Query
	  option. The value has to hold that option, so it is sized for the
	  endpoint client name limit and the "ep=" prefix.

config SIRENA_LWM2M_COAP_LOCATION_SEGMENTS
	int "Maximum number of Location-Path segments in a registration response"
	default 4
	range 1 16

config SIRENA_LWM2M_COAP_PATH_MAX
	int "Maximum length of a CoAP request path"
	default 128
	range 32 256

config SIRENA_LWM2M_COAP_MESSAGE_MAX
	int "Maximum size of a CoAP message"
	default 512
	range 128 2048

endif

rsource "src/samples/lwm2m_client/Kconfig.sample"

rsource "src/tests/conformance/Kconfig.conformance"

endif

endmenu
```

## src/tests/conformance/Kconfig.conformance
```kconfig
menu "Sirena LwM2M conformance harness"

config SIRENA_LWM2M_CONFORMANCE_SERVER_URI
	string "LwM2M server URI the harness registers with"
	default "coap://192.168.0.1:5683"
	help
	  The URI of the server the harness registers with. The address is
	  the one the harness gives to the Linux side of the TAP device the
	  native_sim build creates.

config SIRENA_LWM2M_CONFORMANCE_ENDPOINT_NAME
	string "Endpoint name the harness registers with"
	default "sirena-conformance"
	help
	  The LwM2M Endpoint Client Name of the harness. The server shows
	  it as the name of the registered endpoint.

config SIRENA_LWM2M_CONFORMANCE_LIFETIME
	int "Registration lifetime of the harness in seconds"
	default 300
	range 1 86400

config SIRENA_LWM2M_CONFORMANCE_BINDING
	string "Binding mode the harness registers with"
	default "U"
	help
	  The binding mode the client sends in the registration. The harness
	  checks that the server shows it.

config SIRENA_LWM2M_CONFORMANCE_TELEMETRY_VALUE
	int "Value the harness reports in the telemetry resource"
	default 42

config SIRENA_LWM2M_CONFORMANCE_WRITE_VALUE
	string "Value the harness expects the server to write"
	default "+02:00"
	help
	  The harness writes this value in the UTC offset resource of the
	  device object and checks that the client kept it.

config SIRENA_LWM2M_CONFORMANCE_REGISTRATION_TIMEOUT_MS
	int "Time the harness waits for the registration in milliseconds"
	default 30000
	range 1000 300000
	help
	  The harness retries the registration until the server accepts it.
	  The TAP device only carries traffic once the harness has given its
	  Linux side an address, so the first attempts can fail.

config SIRENA_LWM2M_CONFORMANCE_TELEMETRY_INTERVAL_MS
	int "Interval between the telemetry reports of the harness in milliseconds"
	default 500
	range 100 60000

config SIRENA_LWM2M_CONFORMANCE_COMMAND_TIMEOUT_MS
	int "Time the harness waits for the command of the server in milliseconds"
	default 60000
	range 1000 600000
	help
	  The harness publishes telemetry and waits for the server to observe
	  it, to write a resource and to execute a resource.

endmenu
```
